VERSION "Test DVB to be used with CANdo CAN BUS simulator, based on BMW_e9x"

NS_ :

BS_:

BU_:

BO_ 416 Speed: 8 XXX
 SG_ VehicleSpeed : 0|12@1+ (0.103,0) [0|255] "kph" XXX

BO_ 502 TurnSignals: 2 XXX
 SG_ RightTurn : 5|1@0+ (1,0) [0|1] "" XXX
 SG_ LeftTurn : 4|1@1+ (1,0) [0|1] "" XXX

BO_ 660 Doors: 2 XXX
 SG_ DoorState : 7|1@0+ (1,0) [0|0] "-" Vector__XXX

BO_ 720 HeadLights: 2 XXX
 SG_ LightState : 7|1@0+ (1,0) [0|0] "-" Vector__XXX

VAL_ 660 DoorState 0 "Closed" 1 "Open" ;

VAL_ 720 LightState 0 "Off" 1 "On" ;
